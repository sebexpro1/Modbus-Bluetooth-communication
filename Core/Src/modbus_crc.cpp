

#include "stdint.h"
#include <stdio.h>
#include "main.h"
#include "modbus_crc.h"

extern uint8_t RxData_on_array[64];
extern uint8_t RxData_off_array[64];
extern uint8_t RxData_on_array_AT[64];
extern uint8_t RxData_off_array_AT[64];
extern UART_HandleTypeDef huart4;
extern uint8_t RxData[64];
extern uint8_t TxData[64];
extern uint8_t AT_active[32];
extern uint8_t ATMode;
extern uint8_t BTconnectMode;
extern int bytes;
/* Table of CRC values for high-order byte */
static const uint8_t table_crc_hi[] = {
    0x00, 0xC1, 0x81, 0x40, 0x01, 0xC0, 0x80, 0x41, 0x01, 0xC0,
    0x80, 0x41, 0x00, 0xC1, 0x81, 0x40, 0x01, 0xC0, 0x80, 0x41,
    0x00, 0xC1, 0x81, 0x40, 0x00, 0xC1, 0x81, 0x40, 0x01, 0xC0,
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    0x80, 0x41, 0x00, 0xC1, 0x81, 0x40
};

/* Table of CRC values for low-order byte */
static const uint8_t table_crc_lo[] = {
    0x00, 0xC0, 0xC1, 0x01, 0xC3, 0x03, 0x02, 0xC2, 0xC6, 0x06,
    0x07, 0xC7, 0x05, 0xC5, 0xC4, 0x04, 0xCC, 0x0C, 0x0D, 0xCD,
    0x0F, 0xCF, 0xCE, 0x0E, 0x0A, 0xCA, 0xCB, 0x0B, 0xC9, 0x09,
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    0x43, 0x83, 0x41, 0x81, 0x80, 0x40
};


uint16_t crc16(uint8_t *buffer, uint16_t buffer_length)
{
    uint8_t crc_hi = 0xFF; /* high CRC byte initialized */
    uint8_t crc_lo = 0xFF; /* low CRC byte initialized */
    unsigned int i; /* will index into CRC lookup */

    /* pass through message buffer */
    while (buffer_length--) {
        i = crc_lo ^ *buffer++; /* calculate the CRC  */
        crc_lo = crc_hi ^ table_crc_hi[i];
        crc_hi = table_crc_lo[i];
    }

    return (crc_hi << 8 | crc_lo);
}

void modbus_on_compare_array(){
	RxData_on_array[0] = 0x27;
	RxData_on_array[1] = 0xd;
	RxData_on_array[2] = 0xa;
	RxData_on_array[3] = 0x39;
	RxData_on_array[4] = 0x44;
	RxData_on_array[5] = 0x44;
	RxData_on_array[6] = 0x45;
	RxData_on_array[7] = 0x43;
	RxData_on_array[8] = 0x54;
	RxData_on_array[9] = 0x20;
	RxData_on_array[10] = 0x20;
	RxData_on_array[11] = 0x27;
}
void modbus_on_compare_array_AT(){

	//	RxData_on_array_AT[2] = 0x43; //C
	//	RxData_on_array_AT[3] = 0x4f; //O
	//	RxData_on_array_AT[4] = 0x4e; //N
	//	RxData_on_array_AT[5] = 0x4e; //N
	//	RxData_on_array_AT[6] = 0x45; //E
		RxData_on_array_AT[7] = 0x43; //C
		RxData_on_array_AT[8] = 0x54; //T


}
void modbus_off_compare_array_AT(){

	//	RxData_off_array_AT[2] = 0x44;  //D
		//RxData_off_array_AT[3] = 0x49;  //I
	//	RxData_off_array_AT[4] = 0x53;  //S
		//RxData_off_array_AT[5] = 0x43;  //C
		//RxData_off_array_AT[6] = 0x4f;  //O
		//RxData_off_array_AT[7] = 0x4e;  //N
		//RxData_off_array_AT[8] = 0x4e;  //N
		//RxData_off_array_AT[9] = 0x45;  //E
		RxData_off_array_AT[10] = 0x43; //C
		RxData_off_array_AT[11] = 0x54; //T


}
void modbus_off_compare_array(){
	RxData_off_array[0] = 0x27;
	RxData_off_array[1] = 0xd;
	RxData_off_array[2] = 0xa;
	RxData_off_array[3] = 0x39;
	RxData_off_array[4] = 0x44;
	RxData_off_array[5] = 0x44;
	RxData_off_array[6] = 0x4f;
	RxData_off_array[7] = 0x4e;
	RxData_off_array[8] = 0x4e;
	RxData_off_array[9] = 0x45;
	RxData_off_array[10] = 0x43;
	RxData_off_array[11] = 0x54;
	RxData_off_array[12] = 0x20;
	RxData_off_array[13] = 0x20;
	RxData_off_array[14] = 0x27;
}

int compareArrays(uint8_t arr1[], uint8_t arr2[], int size, int i_start) {
    for (int i = i_start; i < size; ++i) {
        if (arr1[i] != arr2[i]) {
            return 0;
        }
    }
    return 1;
}

int clearArray(uint8_t arr1[], int size) {
    for (int i = 0; i < size; ++i) {
        arr1[i] = 0;
    }
    return 1;
}

void BTM222_init_reset()
{
	HAL_GPIO_WritePin(GPIOF, GPIO_PIN_0,GPIO_PIN_SET);
	HAL_Delay(150);
	HAL_GPIO_WritePin(GPIOF, GPIO_PIN_0,GPIO_PIN_RESET);
	HAL_Delay(150);
	HAL_GPIO_WritePin(GPIOF, GPIO_PIN_0,GPIO_PIN_SET);
	//ATMode = 1;
	//BTconnectMode = 0;
}

void ATMode_on()
{
	uint8_t buff_tosend[8];
	uint8_t buff_tosend2[8];
	sprintf((char *)buff_tosend, "+++\n");

	HAL_Delay(1100);
	HAL_UART_Transmit(&huart4,buff_tosend, 8, 1000);
	//HAL_UART_Receive(&huart4, AT_active, 8, 1000);
	HAL_Delay(1000);
	//clearArray(RxData, 32);
	//sprintf((char *)buff_tosend2, "ATP?\n");
	//HAL_UART_Transmit(&huart4,buff_tosend2, 8, 1000);
	//HAL_UART_Receive(&huart4, AT_active, 8, 1000);

}

void ATMode_Pcom()
{
	uint8_t buff_tosen[8];
	uint8_t buff_tosen2[8];
	sprintf((char *)buff_tosen, "ATP?\n");

	HAL_Delay(1100);
	HAL_UART_Transmit(&huart4,buff_tosen, 8, 1000);
	//HAL_UART_Receive(&huart4, AT_active, 8, 1000);
	HAL_Delay(1000);
	//clearArray(RxData, 32);
	//sprintf((char *)buff_tosend2, "ATP?\n");
	//HAL_UART_Transmit(&huart4,buff_tosend2, 8, 1000);
	//HAL_UART_Receive(&huart4, AT_active, 8, 1000);

}

uint8_t readHoldingRegs (void)
{
	uint16_t startAddr = ((RxData[2]<<8)|RxData[3]);  // start Register Address
	uint16_t numRegs = ((RxData[4]<<8)|RxData[5]);   // number to registers master has requested

	TxData[0] = SLAVE_ID;  // slave ID
	TxData[1] = RxData[1];  // function code
	TxData[2] = numRegs*2;  // Byte count
	int indx = 3;
	TxData[indx++] = 0;
	TxData[indx++] = (HAL_GPIO_ReadPin(GPIOB, GPIO_PIN_14))&0xFF;
	startAddr++;
	TxData[indx++] = 0;
	TxData[indx++] = (HAL_GPIO_ReadPin(GPIOB, GPIO_PIN_14))&0xFF;
	startAddr++;
	for (int i=0; i<(numRegs-2); i++)
	{


		TxData[indx++] = (Holding_Registers_Database[startAddr]>>8)&0xFF;
		TxData[indx++] = (Holding_Registers_Database[startAddr])&0xFF;
		startAddr++;




		}
	//}
		//if(indx == 7){
		//	TxData[indx++] = 0;
		//	TxData[indx++] = (HAL_GPIO_ReadPin(GPIOB, GPIO_PIN_14))&0xFF;
		//	startAddr++;
		//}

		uint16_t crc = crc16(TxData, indx);
		TxData[indx] = crc&0xFF;   // CRC LOW
		TxData[indx+1] = (crc>>8)&0xFF;  // CRC HIGH
		bytes = indx;

	return 1;
}

uint8_t writeSingleReg (void)
{
	uint16_t startAddr = ((RxData[2]<<8)|RxData[3]);

	Holding_Registers_Database[startAddr] = (RxData[4]<<8)|RxData[5];
	if(RxData[3] && ((RxData[4]<<8|RxData[5]) != 0)){
	HAL_GPIO_WritePin(GPIOB, GPIO_PIN_14,GPIO_PIN_SET);// dioda 1 dodaj warunek

	}
	if(RxData[3] && ((RxData[4]<<8|RxData[5]) == 0)){
		HAL_GPIO_WritePin(GPIOB, GPIO_PIN_14,GPIO_PIN_RESET);// dioda 1 dodaj warunek

		}

	TxData[0] = SLAVE_ID;    // slave ID
	TxData[1] = RxData[1];   // function code
	TxData[2] = RxData[2];   // Start Addr HIGH Byte
	TxData[3] = RxData[3];   // Start Addr LOW Byte
	TxData[4] = RxData[4];   // Reg Data HIGH Byte
	TxData[5] = RxData[5];   // Reg Data LOW  Byte

	uint16_t crc = crc16(TxData, 6);
	TxData[6] = crc&0xFF;   // CRC LOW
	TxData[7] = (crc>>8)&0xFF;  // CRC HIGH

	return 1;
}

void sendData (uint8_t *data, int size)
{
	HAL_UART_Transmit(&huart4, data, size, 1000);
}

